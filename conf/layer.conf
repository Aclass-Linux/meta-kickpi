## conf/layer.conf
```bitbake
# We have a conf and classes directory, add to BBPATH
BBPATH .= ":${LAYERDIR}"

# 收录 BSP 配方，JeffyCN 扩展由下方动态规则收录。
BBFILES += "${LAYERDIR}/recipes-*/*/*.bb"

BBFILE_COLLECTIONS += "kickpi"
BBFILE_PATTERN_kickpi = "^${LAYERDIR}/recipes-"
BBFILE_PRIORITY_kickpi = "6"

LAYERDEPENDS_kickpi = "core"
LAYERSERIES_COMPAT_kickpi = "scarthgap"

# Scarthgap unpacks local recipe inputs directly into WORKDIR.
UNPACKDIR ??= "${WORKDIR}"

# BBFILES_DYNAMIC 使用 collection:文件路径，仅在对应 collection 启用时扫描。
# JeffyCN 和社区层都叫 rockchip。先从已启用的层查找 JeffyCN 的基础配方，
# 避免只启用社区层时出现找不到基础配方的 bbappend。
K7_JEFFY_BASE_RECIPE = "${@bb.utils.which(':'.join(d.getVar('BBLAYERS').split()), 'recipes-bsp/u-boot/u-boot-rockchip.bb') or ''}"
K7_JEFFY_APPEND := "${LAYERDIR}/recipes-bsp/u-boot/u-boot-rockchip.bbappend"
BBFILES_DYNAMIC += "${@'rockchip:' + d.getVar('K7_JEFFY_APPEND') if d.getVar('K7_JEFFY_BASE_RECIPE') else ''}"
```

## conf/machine/kickpi-k7.conf
```bitbake
#@TYPE: Machine
#@NAME: KICKPI K7 (RK3576), Rockchip boot chain (bring-up)
require conf/machine/include/arm/armv8a/tune-cortexa72-cortexa53.inc

MACHINE_FEATURES = "usbhost usbgadget ext2"
MACHINE_EXTRA_RRECOMMENDS += "kernel-modules"
K7_CONSOLE_DEVICE = "ttyS0"
K7_CONSOLE_BAUD = "1500000"
SERIAL_CONSOLES = "${K7_CONSOLE_BAUD};${K7_CONSOLE_DEVICE}"

PREFERRED_PROVIDER_virtual/kernel = "linux-k7-rockchip"
KERNEL_IMAGETYPE = "Image"
KERNEL_DEVICETREE = "rockchip/rk3576-kickpi-k7.dtb"

# 启动方案只选择 U-Boot/SPL，Linux 仍使用上述厂商内核。
# 在 local.conf 中设置 K7_BOOT_STACK = "mainline" 可切换到上游源码方案。
K7_BOOT_STACK ?= "oe"
K7_BOOT_PROVIDER = "${@{'rockchip': 'u-boot-k7-rockchip', 'mainline': 'u-boot-k7-mainline', 'oe': 'u-boot', 'jeffy': 'u-boot-rockchip'}.get(d.getVar('K7_BOOT_STACK')) or bb.fatal('K7_BOOT_STACK 只允许 rockchip、mainline、oe 或 jeffy')}"
PREFERRED_PROVIDER_virtual/bootloader = "${K7_BOOT_PROVIDER}"
# 各方案使用不同部署名称，防止切换时误用另一方案的旧产物。
K7_BOOT_PREFIX = "k7-${K7_BOOT_STACK}"

# K7 的默认 defconfig；两条上游路线在共用配方片段中覆盖它。
UBOOT_MACHINE = "rk3576_defconfig"
# K7 使用 FIT 作为启动主产物，不单独部署初始环境文件。
UBOOT_BINARY = "u-boot.itb"
UBOOT_INITIAL_ENV = ""

# 磁盘布局契约（唯一定义处）：WIC 分区偏移与两套 U-Boot 方案的
# 尺寸校验共用。IDB 从 32 KiB 起，FIT 从 8 MiB 起，rootfs 从 16 MiB 起。
K7_LOADER_OFFSET_KIB = "32"
K7_FIT_OFFSET_KIB = "8192"
K7_ROOT_ALIGNMENT_KIB = "16384"
# 由偏移推导的产物尺寸上限（字节），U-Boot 配方 do_compile 校验引用；
# 配置层用 Python 表达式计算，shell 任务不支持 $(( )) 算术展开。
K7_IDB_MAX_BYTES = "${@int(d.getVar('K7_FIT_OFFSET_KIB')) * 1024 - int(d.getVar('K7_LOADER_OFFSET_KIB')) * 1024}"
K7_FIT_MAX_BYTES = "${@int(d.getVar('K7_ROOT_ALIGNMENT_KIB')) * 1024 - int(d.getVar('K7_FIT_OFFSET_KIB')) * 1024}"
```

## layers/meta-product-k7/conf/layer.conf
```bitbake
BBPATH .= ":${LAYERDIR}"
BBFILES += "${LAYERDIR}/recipes-*/*/*.bb ${LAYERDIR}/recipes-*/*/*.bbappend"

BBFILE_COLLECTIONS += "product-k7"
BBFILE_PATTERN_product-k7 = "^${LAYERDIR}/"
BBFILE_PRIORITY_product-k7 = "7"
LAYERDEPENDS_product-k7 = "core kickpi"
LAYERSERIES_COMPAT_product-k7 = "wrynose"
```

## recipes-kernel/linux/files/yocto-k7/defconfig
```kconfig
# K7 upstream baseline, not the vendor 6.1 full configuration.
CONFIG_64BIT=y
CONFIG_ARM64=y
CONFIG_ARCH_ROCKCHIP=y
CONFIG_SMP=y
CONFIG_NR_CPUS=8
CONFIG_ARM_PSCI_FW=y
CONFIG_ARM_ARCH_TIMER=y
CONFIG_ARM_GIC=y
CONFIG_ARM_GIC_V3=y
CONFIG_HZ_250=y
CONFIG_PREEMPT_NONE=y
CONFIG_MODULES=y
CONFIG_MODULE_UNLOAD=y
CONFIG_BLK_DEV_INITRD=y
CONFIG_EXPERT=y
CONFIG_EMBEDDED=y
CONFIG_PRINTK=y
CONFIG_BUG=y
CONFIG_BASE_FULL=y
CONFIG_FUTEX=y
CONFIG_EPOLL=y
CONFIG_SIGNALFD=y
CONFIG_TIMERFD=y
CONFIG_EVENTFD=y
CONFIG_AIO=y
CONFIG_POSIX_TIMERS=y
CONFIG_SYSVIPC=y
CONFIG_POSIX_MQUEUE=y
CONFIG_FHANDLE=y
CONFIG_ADVISE_SYSCALLS=y
CONFIG_MULTIUSER=y
CONFIG_CGROUPS=y
CONFIG_CGROUP_SCHED=y
CONFIG_CGROUP_PIDS=y
CONFIG_MEMCG=y
CONFIG_NAMESPACES=y
CONFIG_UTS_NS=y
CONFIG_IPC_NS=y
CONFIG_PID_NS=y
CONFIG_NET_NS=y
CONFIG_SECCOMP=y
CONFIG_SECCOMP_FILTER=y
CONFIG_KALLSYMS=y
CONFIG_BINFMT_ELF=y
CONFIG_BINFMT_SCRIPT=y
CONFIG_BLOCK=y
CONFIG_PARTITION_ADVANCED=y
CONFIG_EFI_PARTITION=y
CONFIG_MSDOS_PARTITION=y
CONFIG_DEVTMPFS=y
CONFIG_DEVTMPFS_MOUNT=y
CONFIG_TMPFS=y
CONFIG_TMPFS_POSIX_ACL=y
CONFIG_PROC_FS=y
CONFIG_SYSFS=y
CONFIG_EXT4_FS=y
CONFIG_EXT4_FS_POSIX_ACL=y
CONFIG_FAT_FS=y
CONFIG_VFAT_FS=y
CONFIG_NLS_CODEPAGE_437=y
CONFIG_NLS_ISO8859_1=y
CONFIG_NET=y
CONFIG_UNIX=y
CONFIG_INET=y
CONFIG_PACKET=y
CONFIG_NETDEVICES=y
CONFIG_TTY=y
CONFIG_SERIAL_8250=y
CONFIG_SERIAL_8250_CONSOLE=y
CONFIG_SERIAL_8250_DW=y
CONFIG_SERIAL_OF_PLATFORM=y
CONFIG_SERIAL_EARLYCON=y
CONFIG_SERIAL_8250_NR_UARTS=12
CONFIG_SERIAL_8250_RUNTIME_UARTS=12
CONFIG_PINCTRL=y
CONFIG_PINCTRL_ROCKCHIP=y
CONFIG_GPIOLIB=y
CONFIG_GPIO_ROCKCHIP=y
CONFIG_COMMON_CLK=y
CONFIG_COMMON_CLK_ROCKCHIP=y
CONFIG_CLK_RK3576=y
CONFIG_RESET_CONTROLLER=y
CONFIG_ROCKCHIP_PM_DOMAINS=y
CONFIG_PM=y
CONFIG_PM_GENERIC_DOMAINS=y
CONFIG_MFD_SYSCON=y
CONFIG_REGULATOR=y
CONFIG_REGULATOR_FIXED_VOLTAGE=y
CONFIG_MMC=y
CONFIG_MMC_BLOCK=y
CONFIG_MMC_DW=y
CONFIG_MMC_DW_PLTFM=y
CONFIG_MMC_DW_ROCKCHIP=y
CONFIG_MMC_SDHCI=y
CONFIG_MMC_SDHCI_PLTFM=y
CONFIG_MMC_SDHCI_OF_DWCMSHC=y
CONFIG_SCSI=y
CONFIG_BLK_DEV_SD=y
CONFIG_USB=y
CONFIG_USB_DWC3=y
CONFIG_USB_DWC3_DUAL_ROLE=y
CONFIG_USB_DWC3_OF_SIMPLE=y
CONFIG_USB_STORAGE=y
CONFIG_USB_GADGET=y
CONFIG_PHY_ROCKCHIP_INNO_USB2=y
CONFIG_POWER_RESET=y
CONFIG_POWER_RESET_SYSCON=y
CONFIG_ROCKCHIP_SARADC=y
CONFIG_IIO=y
# CONFIG_CPU_FREQ is not set
# CONFIG_DRM is not set
# CONFIG_SOUND is not set
# CONFIG_DEBUG_INFO is not set
```
